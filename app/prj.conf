## CMakeLists.txt
```
cmake_minimum_required(VERSION 3.20.0)

find_package(Zephyr REQUIRED HINTS $ENV{ZEPHYR_BASE})
project(rtoscope)

target_sources(app PRIVATE src/burn.c src/dump.c src/trace.c src/tracer.c src/monitor.c)
target_sources_ifdef(CONFIG_RTOSCOPE_PROBE app PRIVATE src/probe.c)
target_sources_ifdef(CONFIG_RTOSCOPE_WDT app PRIVATE src/watchdog.c)
target_sources_ifdef(CONFIG_RTOSCOPE_DEMO_PERIODIC app PRIVATE src/periodic.c)
target_sources_ifdef(CONFIG_RTOSCOPE_DEMO_INVERSION app PRIVATE src/inversion.c)
```

## Kconfig
```
mainmenu "rtoscope"

choice RTOSCOPE_DEMO
	prompt "Demo to run"
	default RTOSCOPE_DEMO_INVERSION

config RTOSCOPE_DEMO_PERIODIC
	bool "Step 2: three periodic threads"

config RTOSCOPE_DEMO_INVERSION
	bool "Step 3: priority inversion"

endchoice

config RTOSCOPE_PERIODIC_HYPERPERIODS
	int "Hyperperiods to run before dumping the trace"
	depends on RTOSCOPE_DEMO_PERIODIC
	range 1 4
	default 2
	help
	  One hyperperiod of the step 2 task set (3000 ms) is about 280
	  trace records; the ring buffer (TRACE_LEN in trace.c) holds 2048.

config RTOSCOPE_PERIODIC_RUNS
	int "Runs per boot"
	depends on RTOSCOPE_DEMO_PERIODIC
	range 1 1000
	default 1
	help
	  Repeat the whole run (fresh release time, new threads, new trace)
	  this many times in one boot, dumping the trace after each, then
	  print "# rtoscope runs done".

config RTOSCOPE_PROBE
	bool "Periodic demo: tracer-independent job timing probe + tracer bench"
	depends on RTOSCOPE_DEMO_PERIODIC
	help
	  Two CCOUNT reads per job (src/probe.c), dumped after each run, and a
	  benchmark of the tracer's switched_in hook at the end. Used to compare
	  tracers: build with prj.conf (trace.c), -DEXTRA_CONF_FILE=ctf.conf
	  (Zephyr CTF) or -DEXTRA_CONF_FILE=notrace.conf (none).

config RTOSCOPE_MONITOR
	bool "On-device deadline and blocking-time monitor (src/monitor.c)"
	help
	  Inversion demo: H gets a 100 ms deadline and a 60 ms mutex blocking
	  budget. Periodic demo: every job's deadline (= period) is monitored.
	  Findings are "mon" records in the trace.

config RTOSCOPE_INJECT_OVERRUN
	bool "Periodic demo: M's 3rd job overruns by 300 ms (each run)"
	depends on RTOSCOPE_DEMO_PERIODIC
	help
	  A controlled deadline miss for the monitor to catch.

config RTOSCOPE_WDT
	bool "Periodic demo: task watchdog channel per thread, hardware fallback"
	depends on RTOSCOPE_DEMO_PERIODIC
	select WATCHDOG
	select TASK_WDT
	select HWINFO
	select REBOOT
	help
	  Each thread feeds its own task_wdt channel (timeout 2x its period) at
	  the end of every job; TIMG0's hardware watchdog backs up the task
	  watchdog itself. The boot banner reports the reset cause and any "last
	  words" the previous boot left in RTC memory.

choice RTOSCOPE_WDT_TEST
	prompt "Watchdog test fault"
	depends on RTOSCOPE_WDT
	default RTOSCOPE_WDT_TEST_NONE

config RTOSCOPE_WDT_TEST_NONE
	bool "None: a healthy run must never trip the watchdog"

config RTOSCOPE_WDT_TEST_STARVE
	bool "M spins (preemptible) from its 4th job: task watchdog catches it"

config RTOSCOPE_WDT_TEST_HANG
	bool "M spins with interrupts locked from its 4th job: hardware watchdog"

endchoice

if RTOSCOPE_DEMO_INVERSION

choice RTOSCOPE_LOCK
	prompt "Lock protecting the shared resource"
	default RTOSCOPE_LOCK_MUTEX_PI

config RTOSCOPE_LOCK_MUTEX_PI
	bool "k_mutex with priority inheritance"

config RTOSCOPE_LOCK_MUTEX_NO_PI
	bool "k_mutex with priority inheritance compiled out"

endchoice

config RTOSCOPE_M_WORK_MS
	int "CPU time the medium thread burns (ms)"
	default 200

endif

# A ceiling at or below the idle priority (K_LOWEST_THREAD_PRIO, which is
# NUM_PREEMPT_PRIORITIES) compiles k_mutex priority inheritance out.
# Defaults given here take precedence over the kernel's own default.
config PRIORITY_CEILING
	default NUM_PREEMPT_PRIORITIES if RTOSCOPE_LOCK_MUTEX_NO_PI

source "Kconfig.zephyr"
```

## prj.conf
```kconfig
# Per-thread CPU-time accounting, so burn_cpu_ms() can count CPU time
# the thread actually received rather than wall-clock time.
CONFIG_THREAD_RUNTIME_STATS=y
CONFIG_SCHED_THREAD_USAGE=y

# User-defined tracing hooks (src/trace.c) for every context switch,
# wake-up, pend and priority change. ctf.conf / notrace.conf swap these.
CONFIG_TRACING=y
CONFIG_TRACING_USER=y
# Explicit, so builds without CONFIG_TRACING (which implies it) still name threads.
CONFIG_THREAD_NAME=y

# crc32_ieee_update() for the trace dump checksum.
CONFIG_CRC=y
```

## ctf.conf
```kconfig
# Zephyr's CTF tracer instead of src/trace.c (phase 2, step 5):
#   west build ... -- -DEXTRA_CONF_FILE=ctf.conf [-DCONFIG_TRACING_ISR=n]
# Sync mode: events go straight to the backend inside the hook. The default,
# async mode, adds a tracing thread whose flushing would perturb the schedule
# being measured.
CONFIG_TRACING_USER=n
CONFIG_TRACING_CTF=y
CONFIG_TRACING_SYNC=y
CONFIG_TRACING_BACKEND_RAM=y
CONFIG_RAM_TRACING_BUFFER_SIZE=32768
# Start disabled; the app enables it around the run (tracing_cmd_handle).
CONFIG_TRACING_HANDLE_HOST_CMD=y
```

## notrace.conf
```kconfig
# No tracer at all: the baseline for comparing tracers (phase 2, step 5):
#   west build ... -- -DEXTRA_CONF_FILE=notrace.conf
CONFIG_TRACING=n
CONFIG_TRACING_USER=n
```

## src/burn.c
```c
#include <zephyr/kernel.h>

#include "burn.h"

/*
 * k_busy_wait() measures wall-clock time: if the thread is preempted for
 * 20 ms during a 150 ms busy-wait, it only gets 130 ms of real work done.
 * Asking the scheduler how many cycles this thread has actually run fixes that.
 */
void burn_cpu_ms(uint32_t ms)
{
	k_thread_runtime_stats_t stats;
	uint64_t end;

	k_thread_runtime_stats_get(k_current_get(), &stats);
	end = stats.execution_cycles + k_ms_to_cyc_ceil64(ms);

	do {
		k_thread_runtime_stats_get(k_current_get(), &stats);
	} while (stats.execution_cycles < end);
}
```

## src/burn.h
```c
#ifndef RTOSCOPE_BURN_H
#define RTOSCOPE_BURN_H

#include <stdint.h>

/* Spin until the calling thread has received ms of CPU time. */
void burn_cpu_ms(uint32_t ms);

#endif
```

## src/dump.c
```c
#include <stdarg.h>

#include <zephyr/kernel.h>
#include <zephyr/sys/crc.h>
#include <zephyr/sys/printk.h>

#include "dump.h"

uint32_t dump_line(uint32_t crc, const char *fmt, ...)
{
	char line[128];
	va_list ap;
	int len;

	va_start(ap, fmt);
	len = vsnprintk(line, sizeof(line), fmt, ap);
	va_end(ap);
	len = MIN(len, (int)sizeof(line) - 1);

	printk("%s", line);
	return crc32_ieee_update(crc, (const uint8_t *)line, len);
}

void dump_crc(uint32_t crc)
{
	printk("# crc32 %08x\n", crc);
}
```

## src/dump.h
```c
#ifndef RTOSCOPE_DUMP_H
#define RTOSCOPE_DUMP_H

#include <stdint.h>

/*
 * Print one line of a dump and fold it into a running CRC-32 (IEEE, same as
 * Python's zlib.crc32). Every dump ends with "# crc32 xxxxxxxx" over its
 * lines: the UART -> USB -> host path can lose bytes (seen once in 690 KB on
 * the CYD's CH340), and a lost digit would still parse.
 *
 * Start with crc = 0; fmt must produce one line ending in "\n", < 128 chars.
 */
uint32_t dump_line(uint32_t crc, const char *fmt, ...);

/* Print the closing "# crc32 xxxxxxxx" line. */
void dump_crc(uint32_t crc);

#endif
```

## src/inversion.c
```c
/*
 * Step 3: priority inversion, with and without priority inheritance.
 *
 * Classic scenario, run once per boot:
 *   t =  0  L (prio 9) locks the shared mutex, starts a 50 ms critical section
 *   t = 10  H (prio 5) wakes and tries to lock it -> blocks
 *   t = 20  M (prio 7) wakes and burns CPU, never touching the mutex
 *
 * Without PI, M preempts L, so H waits for M's whole run (unbounded).
 * With PI, L runs at H's priority while H waits, so M can't preempt it
 * and H waits only for the rest of L's critical section (bounded).
 *
 * The scheduler trace (trace.c) records every switch, wake-up and priority
 * change during the run; it is printed after all threads finish, so printing
 * doesn't perturb the run.
 */

#include <zephyr/kernel.h>
#include <zephyr/sys/printk.h>

#include "burn.h"
#include "monitor.h"
#include "trace.h"

#define STACK_SIZE 2048

#define PRIO_H 5
#define PRIO_M 7
#define PRIO_L 9

#define L_CS_MS    50
#define H_CS_MS    10
#define H_DELAY_MS 10
#define M_DELAY_MS 20

/* Monitor bounds for H (CONFIG_RTOSCOPE_MONITOR): its deadline, relative to
 * its release, and how long it may wait for the mutex: L's whole critical
 * section plus a margin. With PI H waits 40 ms; without, 240 ms.
 */
#define H_DEADLINE_MS     100
#define H_BLOCK_BUDGET_MS (L_CS_MS + 10)

#if defined(CONFIG_RTOSCOPE_LOCK_MUTEX_PI)
#define MODE_NAME "k_mutex, priority inheritance ON"
#else
#define MODE_NAME "k_mutex, priority inheritance OFF (CONFIG_PRIORITY_CEILING)"
#endif

K_MUTEX_DEFINE(resource);

K_THREAD_STACK_DEFINE(stack_h, STACK_SIZE);
K_THREAD_STACK_DEFINE(stack_m, STACK_SIZE);
K_THREAD_STACK_DEFINE(stack_l, STACK_SIZE);
static struct k_thread thread_h, thread_m, thread_l;

static int64_t release_ms;

static struct mon_deadline h_deadline;
static struct mon_block h_block;

static void low_entry(void *p1, void *p2, void *p3)
{
	k_sleep(K_TIMEOUT_ABS_MS(release_ms));
	trace_app("lock request");
	k_mutex_lock(&resource, K_FOREVER);
	trace_app("locked");
	burn_cpu_ms(L_CS_MS);
	trace_app("unlock");
	k_mutex_unlock(&resource);
	trace_app("done");
}

static void high_entry(void *p1, void *p2, void *p3)
{
	const bool mon = IS_ENABLED(CONFIG_RTOSCOPE_MONITOR);

	/* Armed before the release, so even a job that never starts is caught. */
	if (mon) {
		mon_deadline_arm(&h_deadline, release_ms + H_DELAY_MS + H_DEADLINE_MS);
	}
	k_sleep(K_TIMEOUT_ABS_MS(release_ms + H_DELAY_MS));
	trace_app("lock request");
	if (mon) {
		mon_block_begin(&h_block, &resource, H_BLOCK_BUDGET_MS);
	}
	k_mutex_lock(&resource, K_FOREVER);
	if (mon) {
		mon_block_end(&h_block);
	}
	trace_app("locked");
	burn_cpu_ms(H_CS_MS);
	trace_app("unlock");
	k_mutex_unlock(&resource);
	trace_app("done");
	if (mon) {
		mon_deadline_done(&h_deadline);
	}
}

static void medium_entry(void *p1, void *p2, void *p3)
{
	k_sleep(K_TIMEOUT_ABS_MS(release_ms + M_DELAY_MS));
	trace_app("start");
	burn_cpu_ms(CONFIG_RTOSCOPE_M_WORK_MS);
	trace_app("done");
}

int main(void)
{
	printk("rtoscope step 3: %s, M work %d ms, PRIORITY_CEILING=%d\n",
	       MODE_NAME, CONFIG_RTOSCOPE_M_WORK_MS, CONFIG_PRIORITY_CEILING);
	if (IS_ENABLED(CONFIG_RTOSCOPE_MONITOR)) {
		printk("# monitor: H deadline %d ms after release, blocking budget %d ms\n",
		       H_DEADLINE_MS, H_BLOCK_BUDGET_MS);
	}
	mon_deadline_init(&h_deadline, &thread_h);
	mon_block_init(&h_block, &thread_h);

	release_ms = k_uptime_get() + 10;
	trace_start();

	k_thread_create(&thread_l, stack_l, K_THREAD_STACK_SIZEOF(stack_l),
			low_entry, NULL, NULL, NULL, PRIO_L, 0, K_NO_WAIT);
	k_thread_name_set(&thread_l, "L");
	k_thread_create(&thread_m, stack_m, K_THREAD_STACK_SIZEOF(stack_m),
			medium_entry, NULL, NULL, NULL, PRIO_M, 0, K_NO_WAIT);
	k_thread_name_set(&thread_m, "M");
	k_thread_create(&thread_h, stack_h, K_THREAD_STACK_SIZEOF(stack_h),
			high_entry, NULL, NULL, NULL, PRIO_H, 0, K_NO_WAIT);
	k_thread_name_set(&thread_h, "H");

	/* main (prio 0) blocks here; the demo threads run, then exit. */
	k_thread_join(&thread_h, K_FOREVER);
	k_thread_join(&thread_m, K_FOREVER);
	k_thread_join(&thread_l, K_FOREVER);

	trace_stop();
	trace_dump();
	if (IS_ENABLED(CONFIG_RTOSCOPE_MONITOR)) {
		printk("# monitor: H deadline misses %u, blocking alarms %u\n",
		       h_deadline.misses, h_block.alarms);
	}
	return 0;
}
```

## src/monitor.c
```c
/*
 * On-device deadline and blocking-time monitors (phase 2, step 4).
 *
 * Both detect at the moment a bound is exceeded (k_timer expiry), not when
 * the late work eventually completes.
 */

#include <zephyr/kernel.h>

#include "monitor.h"
#include "trace.h"

static void deadline_expired(struct k_timer *timer)
{
	struct mon_deadline *m = CONTAINER_OF(timer, struct mon_deadline, timer);

	m->misses++;
	trace_mon(m->thread, "deadline miss");
	/* In ISR context k_current_get() is the thread that was interrupted. */
	trace_mon(k_current_get(), "running at alarm");
}

void mon_deadline_init(struct mon_deadline *m, struct k_thread *thread)
{
	k_timer_init(&m->timer, deadline_expired, NULL);
	m->thread = thread;
	m->misses = 0;
}

void mon_deadline_arm(struct mon_deadline *m, int64_t deadline_ms)
{
	k_timer_start(&m->timer, K_TIMEOUT_ABS_MS(deadline_ms), K_NO_WAIT);
}

void mon_deadline_done(struct mon_deadline *m)
{
	k_timer_stop(&m->timer);
}

/*
 * The snapshot says what kind of blocking this is: if the owner is running
 * (at its own or an inherited priority), the wait is bounded by its critical
 * section; if some third thread is running instead, it's unbounded priority
 * inversion. The analysis tools classify it from these records.
 */
static void block_expired(struct k_timer *timer)
{
	struct mon_block *b = CONTAINER_OF(timer, struct mon_block, timer);
	struct k_thread *owner = b->mutex->owner;

	b->alarms++;
	trace_mon(b->waiter, "blocked too long");
	trace_mon(k_current_get(), "running at alarm");
	if (owner != NULL) {
		trace_mon(owner, "mutex owner");
	}
}

void mon_block_init(struct mon_block *b, struct k_thread *waiter)
{
	k_timer_init(&b->timer, block_expired, NULL);
	b->waiter = waiter;
	b->mutex = NULL;
	b->alarms = 0;
}

void mon_block_begin(struct mon_block *b, struct k_mutex *mutex, uint32_t budget_ms)
{
	b->mutex = mutex;
	k_timer_start(&b->timer, K_MSEC(budget_ms), K_NO_WAIT);
}

void mon_block_end(struct mon_block *b)
{
	k_timer_stop(&b->timer);
}
```

## src/monitor.h
```c
#ifndef RTOSCOPE_MONITOR_H
#define RTOSCOPE_MONITOR_H

/*
 * On-device timing monitors. Each is a one-shot k_timer that fires only if
 * something has gone wrong; the expiry handler (ISR context) records the
 * finding in the trace with trace_mon(). No printing.
 */

#include <zephyr/kernel.h>

/* Deadline monitor: did the job finish by its deadline? (timeliness) */
struct mon_deadline {
	struct k_timer timer;
	struct k_thread *thread;
	uint32_t misses;
};

void mon_deadline_init(struct mon_deadline *m, struct k_thread *thread);

/*
 * Arm for the job released next, at its absolute deadline (uptime ms). Call
 * BEFORE sleeping until the release: if a job only armed itself once it
 * started, a job starved past its own deadline would never be detected.
 */
void mon_deadline_arm(struct mon_deadline *m, int64_t deadline_ms);

/* The job finished: cancel the timer. */
void mon_deadline_done(struct mon_deadline *m);

/* Blocking monitor: was a thread kept waiting on a mutex beyond a budget? */
struct mon_block {
	struct k_timer timer;
	struct k_thread *waiter;
	struct k_mutex *mutex;
	uint32_t alarms;
};

void mon_block_init(struct mon_block *b, struct k_thread *waiter);

/* Call right before k_mutex_lock(mutex) / right after it returns. */
void mon_block_begin(struct mon_block *b, struct k_mutex *mutex, uint32_t budget_ms);
void mon_block_end(struct mon_block *b);

#endif
```

## src/periodic.c
```c
/*
 * Step 2: three periodic threads at different preemptive priorities.
 *
 * Each thread loops: sleep until its release, log "start", burn some CPU time
 * ("work"), log "done". Periods collide, so a higher-priority thread wakes up
 * while a lower one is mid-work and preempts it.
 *
 * A run lasts CONFIG_RTOSCOPE_PERIODIC_HYPERPERIODS hyperperiods, then every
 * thread exits and main dumps the scheduler trace (trace.c). Nothing is
 * printed during a run. One boot does CONFIG_RTOSCOPE_PERIODIC_RUNS runs.
 *
 * Optional (phase 2, step 4): every job's deadline is monitored
 * (CONFIG_RTOSCOPE_MONITOR), M's 3rd job can overrun on purpose
 * (CONFIG_RTOSCOPE_INJECT_OVERRUN), and each thread can feed its own task
 * watchdog channel, with a controlled fault in M's 4th job
 * (CONFIG_RTOSCOPE_WDT, CONFIG_RTOSCOPE_WDT_TEST_*).
 */

#include <zephyr/kernel.h>
#include <zephyr/sys/printk.h>

#include "burn.h"
#include "monitor.h"
#include "trace.h"
#include "tracer.h"
#if defined(CONFIG_RTOSCOPE_PROBE)
#include "probe.h"
#endif
#if defined(CONFIG_RTOSCOPE_WDT)
#include "watchdog.h"
#endif

#define STACK_SIZE 2048

struct task_cfg {
	const char *name;
	int prio;           /* Zephyr: lower number = higher priority */
	uint32_t work_ms;   /* CPU time to burn per period */
	uint32_t period_ms;
};

static const struct task_cfg tasks[] = {
	{ "H", 5,  15,  100 },
	{ "M", 7,  40,  300 },
	{ "L", 9, 180, 1000 },
};

#define NUM_TASKS ARRAY_SIZE(tasks)
#define TASK_M    1

#define OVERRUN_JOB 3      /* CONFIG_RTOSCOPE_INJECT_OVERRUN: M's 3rd job... */
#define OVERRUN_MS  300    /* ...burns this much extra: a deadline miss */
#define FAULT_JOB   4      /* CONFIG_RTOSCOPE_WDT_TEST_*: M's 4th job hangs */

K_THREAD_STACK_ARRAY_DEFINE(stacks, NUM_TASKS, STACK_SIZE);
static struct k_thread threads[NUM_TASKS];

/* Common release time (uptime ms) for every thread's first period, set by
 * main before any thread is created. Without it, each thread would anchor its
 * period at its first run, which is later for lower priorities.
 */
static int64_t release_ms;

/* No job is released at or after this time (uptime ms). */
static int64_t end_ms;

static struct mon_deadline deadlines[NUM_TASKS];

/* False on a boot that follows a watchdog test reset: inject only once. */
static bool inject_wdt_fault;

#if defined(CONFIG_RTOSCOPE_WDT)
static void report_misses(void)
{
	printk("# monitor: deadline misses so far H %u, M %u, L %u\n", deadlines[0].misses,
	       deadlines[1].misses, deadlines[2].misses);
}
#endif

/* Never returns: the watchdog has to end it. */
static void wdt_fault(void)
{
#if defined(CONFIG_RTOSCOPE_WDT)
	if (IS_ENABLED(CONFIG_RTOSCOPE_WDT_TEST_STARVE)) {
		/* Preemptible: H keeps running, L starves, M stops feeding. */
		watchdog_note_fault("starve");
		trace_app("fault: starve");
		while (true) {
			arch_nop();
		}
	}
	/* Interrupts locked: no scheduler, no task_wdt timer. Only TIMG0. */
	watchdog_note_fault("hang");
	(void)irq_lock();
	while (true) {
		arch_nop();
	}
#endif
}

static void task_entry(void *p1, void *p2, void *p3)
{
	const struct task_cfg *cfg = p1;
	const int idx = cfg - tasks;
	int64_t next = release_ms;
	int channel = -1;

	ARG_UNUSED(p2);
	ARG_UNUSED(p3);

#if defined(CONFIG_RTOSCOPE_WDT)
	/* 2x the period: one late job is tolerated, a stalled thread is not. */
	channel = watchdog_add(cfg->name, 2 * cfg->period_ms);
#endif

	for (int job = 1; next < end_ms; job++) {
		/* Arm before sleeping: a job starved past its deadline still trips it. */
		if (IS_ENABLED(CONFIG_RTOSCOPE_MONITOR)) {
			mon_deadline_arm(&deadlines[idx], next + cfg->period_ms);
		}

		/* Absolute release time: a relative k_msleep(period) would drift by
		 * however long the work (and any preemption) took.
		 */
		k_sleep(K_TIMEOUT_ABS_MS(next));
#if defined(CONFIG_RTOSCOPE_PROBE)
		probe_wake(idx, job);
#endif

		trace_app("start");
		burn_cpu_ms(cfg->work_ms);
		if (IS_ENABLED(CONFIG_RTOSCOPE_INJECT_OVERRUN) && idx == TASK_M &&
		    job == OVERRUN_JOB) {
			trace_app("overrun");
			burn_cpu_ms(OVERRUN_MS);
		}
		if (inject_wdt_fault && idx == TASK_M && job == FAULT_JOB) {
			wdt_fault();
		}
		trace_app("done");
#if defined(CONFIG_RTOSCOPE_PROBE)
		probe_done(idx, job);
#endif

		if (IS_ENABLED(CONFIG_RTOSCOPE_MONITOR)) {
			mon_deadline_done(&deadlines[idx]);
		}
#if defined(CONFIG_RTOSCOPE_WDT)
		watchdog_feed(channel);
#endif
		next += cfg->period_ms;
	}

#if defined(CONFIG_RTOSCOPE_WDT)
	/* A channel left behind by an exited thread would expire. */
	watchdog_remove(channel);
#else
	ARG_UNUSED(channel);
#endif
}

static uint32_t gcd(uint32_t a, uint32_t b)
{
	while (b != 0) {
		uint32_t t = a % b;

		a = b;
		b = t;
	}
	return a;
}

int main(void)
{
	uint32_t hyper_ms = 1;

	for (int i = 0; i < NUM_TASKS; i++) {
		hyper_ms = hyper_ms / gcd(hyper_ms, tasks[i].period_ms) * tasks[i].period_ms;
	}

	printk("# tracer: %s\n", tracer_name);
	/* The analysis script reads the task set from here, not from a copy. */
	printk("rtoscope periodic: %d hyperperiods of %u ms\n",
	       CONFIG_RTOSCOPE_PERIODIC_HYPERPERIODS, hyper_ms);
	printk("# task,name,prio,work_ms,period_ms\n");
	for (int i = 0; i < NUM_TASKS; i++) {
		printk("# task,%s,%d,%u,%u\n", tasks[i].name, tasks[i].prio,
		       tasks[i].work_ms, tasks[i].period_ms);
	}

#if defined(CONFIG_RTOSCOPE_WDT)
	bool recovered = watchdog_boot_report();

	inject_wdt_fault = !recovered && !IS_ENABLED(CONFIG_RTOSCOPE_WDT_TEST_NONE);
	printk("# wdt: test %s, fault %s\n",
	       IS_ENABLED(CONFIG_RTOSCOPE_WDT_TEST_STARVE) ? "starve" :
	       IS_ENABLED(CONFIG_RTOSCOPE_WDT_TEST_HANG) ? "hang" : "none",
	       inject_wdt_fault ? "armed (M, job 4)" : "not armed");
	watchdog_set_report_hook(report_misses);
	if (watchdog_start() != 0) {
		printk("# wdt: task_wdt_init failed\n");
	}
#endif
	if (IS_ENABLED(CONFIG_RTOSCOPE_MONITOR)) {
		printk("# monitor: deadline = period for every job\n");
	}
	for (int i = 0; i < NUM_TASKS; i++) {
		mon_deadline_init(&deadlines[i], &threads[i]);
	}

	for (int run = 1; run <= CONFIG_RTOSCOPE_PERIODIC_RUNS; run++) {
		/* All three sleep until the same release time, slightly in the
		 * future, so the first period starts together no matter how long
		 * thread creation takes. They then wake together and the
		 * scheduler picks H.
		 */
		release_ms = k_uptime_get() + 10;
		end_ms = release_ms + (int64_t)CONFIG_RTOSCOPE_PERIODIC_HYPERPERIODS * hyper_ms;
#if defined(CONFIG_RTOSCOPE_PROBE)
		probe_reset();
#endif
		tracer_start();

		/* Reusing a k_thread is fine once k_thread_join() has seen it exit. */
		for (int i = 0; i < NUM_TASKS; i++) {
			k_tid_t tid = k_thread_create(&threads[i], stacks[i],
						      K_THREAD_STACK_SIZEOF(stacks[i]),
						      task_entry, (void *)&tasks[i], NULL, NULL,
						      tasks[i].prio, 0, K_NO_WAIT);
			k_thread_name_set(tid, tasks[i].name);
		}

		for (int i = 0; i < NUM_TASKS; i++) {
			k_thread_join(&threads[i], K_FOREVER);
		}

		tracer_stop();
		printk("# run %d/%d\n", run, CONFIG_RTOSCOPE_PERIODIC_RUNS);
		tracer_dump();
#if defined(CONFIG_RTOSCOPE_PROBE)
		{
			const char *names[NUM_TASKS];

			for (int i = 0; i < NUM_TASKS; i++) {
				names[i] = tasks[i].name;
			}
			probe_dump(names, NUM_TASKS);
		}
#endif
		if (IS_ENABLED(CONFIG_RTOSCOPE_MONITOR)) {
			printk("# monitor: deadline misses so far H %u, M %u, L %u\n",
			       deadlines[0].misses, deadlines[1].misses, deadlines[2].misses);
		}
	}

	if (IS_ENABLED(CONFIG_RTOSCOPE_PROBE)) {
		tracer_bench();
	}
	printk("# rtoscope runs done\n");
	return 0;
}
```

## src/probe.c
```c
#include <string.h>

#include <zephyr/kernel.h>

#include "dump.h"
#include "probe.h"

#define PROBE_TASKS 3
#define PROBE_JOBS  64   /* H has 30 jobs per 3 s hyperperiod */

static uint32_t wake[PROBE_TASKS][PROBE_JOBS];
static uint32_t done[PROBE_TASKS][PROBE_JOBS];
static int last_job[PROBE_TASKS];

void probe_reset(void)
{
	memset(wake, 0, sizeof(wake));
	memset(done, 0, sizeof(done));
	memset(last_job, 0, sizeof(last_job));
}

void probe_wake(int task, int job)
{
	if (task < PROBE_TASKS && job >= 1 && job <= PROBE_JOBS) {
		wake[task][job - 1] = k_cycle_get_32();
	}
}

void probe_done(int task, int job)
{
	if (task < PROBE_TASKS && job >= 1 && job <= PROBE_JOBS) {
		done[task][job - 1] = k_cycle_get_32();
		last_job[task] = MAX(last_job[task], job);
	}
}

void probe_dump(const char *const names[], int ntasks)
{
	uint32_t t0 = wake[0][0];   /* H's first wake: the first release */
	uint32_t crc = 0;
	int jobs = 0;

	for (int t = 0; t < ntasks && t < PROBE_TASKS; t++) {
		jobs += last_job[t];
	}
	crc = dump_line(crc, "# rtoscope probe, cycle clock %u Hz, %d jobs\n",
			sys_clock_hw_cycles_per_sec(), jobs);
	crc = dump_line(crc, "task,job,wake,done\n");
	for (int t = 0; t < ntasks && t < PROBE_TASKS; t++) {
		for (int j = 0; j < last_job[t]; j++) {
			/* Unsigned subtraction stays correct across one CCOUNT wrap. */
			crc = dump_line(crc, "%s,%d,%u,%u\n", names[t], j + 1,
					wake[t][j] - t0, done[t][j] - t0);
		}
	}
	dump_crc(crc);
}
```

## src/probe.h
```c
#ifndef RTOSCOPE_PROBE_H
#define RTOSCOPE_PROBE_H

/*
 * Tracer-independent timing probe (phase 2, step 5): two CCOUNT reads per
 * job, stored in a static array, so the same measurement runs unchanged
 * whether trace.c, Zephyr's CTF tracer, or no tracer is built in.
 */

void probe_reset(void);
void probe_wake(int task, int job);   /* right after the job's release sleep */
void probe_done(int task, int job);   /* when the job's work is finished */

/* "# rtoscope probe ..." block with CRC; names[i] labels task i. */
void probe_dump(const char *const names[], int ntasks);

#endif
```

## src/trace.c
```c
/*
 * Scheduler event trace (goal 4).
 *
 * Implements Zephyr's CONFIG_TRACING_USER hooks (weak no-ops in
 * subsys/tracing/user/tracing_user.c) to record every context switch,
 * wake-up, pend and priority change, plus app events from trace_app() and
 * monitor findings from trace_mon().
 *
 * Hot path rule: a hook only takes a timestamp and stores a 16-byte record.
 * Thread names, formatting and UART output all happen in trace_dump().
 */

#include <zephyr/kernel.h>
#include <zephyr/kernel_structs.h>
#include <zephyr/sys/printk.h>
#include <zephyr/sys/util.h>

#include "dump.h"
#include "trace.h"

enum ev_type {
	EV_IN,     /* thread got the CPU */
	EV_OUT,    /* thread left the CPU; state says why */
	EV_READY,  /* thread became runnable: release, or unblocked */
	EV_PEND,   /* thread started waiting on a kernel object */
	EV_PRIO,   /* priority changed (k_mutex inheritance boost/restore) */
	EV_APP,    /* trace_app() label */
	EV_MON,    /* trace_mon() label: a monitor finding about a thread */
};

static const char *const ev_names[] = { "in", "out", "ready", "pend", "prio", "app", "mon" };

struct rec {
	uint32_t cyc;              /* k_cycle_get_32(): CCOUNT, 240 MHz */
	struct k_thread *thread;
	const char *what;          /* EV_APP only */
	uint8_t type;
	int8_t prio;               /* thread's priority; for EV_PRIO the new one */
	uint8_t state;             /* EV_OUT: outgoing thread's base.thread_state */
	uint8_t pad;
};

/* Power of two, so the slot index is a mask, not a division.
 * 2048 x 16 B = 32 KB: room for several hyperperiods of the periodic demo.
 */
#define TRACE_LEN 2048
BUILD_ASSERT(IS_POWER_OF_TWO(TRACE_LEN));

static struct rec ring[TRACE_LEN];
static uint32_t head;           /* records ever written; slot = head % TRACE_LEN */
static volatile bool armed;
static uint32_t call_cycles;    /* measured cost of one record() */

/*
 * The kernel hooks already run with interrupts masked (Xtensa switch path,
 * or the scheduler spinlock, which on one core is an IRQ lock). trace_app()
 * runs in preemptible thread context, so the slot claim and the write need
 * the lock too. The timestamp is taken inside it so records stay in
 * time order. When full, the oldest records are overwritten.
 */
static void record(uint8_t type, struct k_thread *thread, int prio, uint8_t state,
		   const char *what)
{
	unsigned int key;

	if (!armed) {
		return;
	}

	key = irq_lock();
	ring[head & (TRACE_LEN - 1)] = (struct rec){
		.cyc = k_cycle_get_32(),
		.thread = thread,
		.what = what,
		.type = type,
		.prio = prio,
		.state = state,
	};
	head++;
	irq_unlock(key);
}

/* --- Zephyr user tracing hooks --------------------------------------- */

/* Called before _current changes, so _current is the outgoing thread. */
void sys_trace_thread_switched_out_user(void)
{
	struct k_thread *t = k_current_get();

	record(EV_OUT, t, t->base.prio, t->base.thread_state, NULL);
}

/* Called from the Xtensa switch/ISR-exit asm after _current changes. */
void sys_trace_thread_switched_in_user(void)
{
	struct k_thread *t = k_current_get();

	record(EV_IN, t, t->base.prio, 0, NULL);
}

void sys_trace_thread_sched_ready_user(struct k_thread *thread)
{
	record(EV_READY, thread, thread->base.prio, 0, NULL);
}

void sys_trace_thread_pend_user(struct k_thread *thread)
{
	record(EV_PEND, thread, thread->base.prio, 0, NULL);
}

void sys_trace_thread_priority_set_user(struct k_thread *thread, int prio)
{
	record(EV_PRIO, thread, prio, 0, NULL);
}

/* --- API -------------------------------------------------------------- */

void trace_app(const char *what)
{
	struct k_thread *t = k_current_get();

	record(EV_APP, t, t->base.prio, 0, what);
}

void trace_mon(struct k_thread *thread, const char *what)
{
	record(EV_MON, thread, thread->base.prio, 0, what);
}

void trace_start(void)
{
	head = 0;
	armed = true;

	/* Back-to-back records: the gap between two timestamps is the cost of
	 * one trace call, i.e. how much tracing perturbs the run. Take the
	 * minimum over several: code runs from SPI flash through the cache, so
	 * the first calls pay for cache misses (~1000 cycles, measured).
	 */
	for (int i = 0; i < 8; i++) {
		trace_app("cal");
	}
	call_cycles = UINT32_MAX;
	for (int i = 1; i < 8; i++) {
		call_cycles = MIN(call_cycles, ring[i].cyc - ring[i - 1].cyc);
	}
	head = 0;
}

void trace_stop(void)
{
	armed = false;
}

/* Why the outgoing thread left the CPU. */
static const char *state_name(uint8_t s)
{
	if (s & _THREAD_DEAD) {
		return "dead";
	}
	if (s & _THREAD_PENDING) {
		return "pending";
	}
	if (s & _THREAD_SLEEPING) {
		return "sleeping";
	}
	if (s & _THREAD_SUSPENDED) {
		return "suspended";
	}
	return "ready";  /* still runnable: it was preempted */
}

void trace_dump(void)
{
	uint32_t n = MIN(head, TRACE_LEN);
	uint32_t first = head - n;
	uint32_t t0 = ring[first & (TRACE_LEN - 1)].cyc;
	uint32_t crc = 0;

	crc = dump_line(crc, "# rtoscope trace, cycle clock %u Hz, %u events, %u dropped, "
			"trace call %u cycles\n",
			sys_clock_hw_cycles_per_sec(), n, head - n, call_cycles);
	crc = dump_line(crc, "cycles,thread,event,prio,arg\n");

	for (uint32_t i = first; i < head; i++) {
		const struct rec *r = &ring[i & (TRACE_LEN - 1)];
		const char *name = k_thread_name_get(r->thread);
		const char *arg = r->type == EV_OUT ? state_name(r->state) :
				  r->what != NULL ? r->what : "";

		/* Unsigned subtraction stays correct across one CCOUNT wrap. */
		if (name != NULL && name[0] != '\0') {
			crc = dump_line(crc, "%u,%s,%s,%d,%s\n", r->cyc - t0, name,
					ev_names[r->type], r->prio, arg);
		} else {
			crc = dump_line(crc, "%u,%p,%s,%d,%s\n", r->cyc - t0, r->thread,
					ev_names[r->type], r->prio, arg);
		}
	}

	dump_crc(crc);
}
```

## src/trace.h
```c
#ifndef RTOSCOPE_TRACE_H
#define RTOSCOPE_TRACE_H

/*
 * Scheduler event trace: Zephyr's user tracing hooks plus app events, stamped
 * with CCOUNT (k_cycle_get_32() on this board) into a RAM ring buffer.
 * Nothing is printed until trace_dump().
 */

/* Start/stop recording. Hooks are cheap no-ops while stopped. */
void trace_start(void);
void trace_stop(void);

/* Record an app-level event for the current thread. what must be a string
 * literal (only the pointer is stored).
 */
void trace_app(const char *what);

/* Record a monitor finding about any thread (not necessarily the current
 * one); safe from ISR context, e.g. a k_timer expiry. prio is the thread's
 * priority at that moment. what must be a string literal.
 */
struct k_thread;
void trace_mon(struct k_thread *thread, const char *what);

/* Print the buffer as CSV over the console, followed by a CRC-32 of the
 * dump ("# crc32 xxxxxxxx"). Call after trace_stop().
 */
void trace_dump(void);

#endif
```
